## src/library/components/anybus_interface/drivers_templates/armadeus/Kconfig
```kconfig
config ARMADEUS_FPGA_POD_ANYBUS_INTERFACE_DRIVER
	tristate "POD anybus interface driver"
	default n
	depends on POD_DRIVERS 
	select ARMADEUS_FPGA_VIRTUAL_COMPONENT_ANYBUS_INTERFACE
	---help---
```

## src/library/components/button/drivers_templates/armadeus/Kconfig
```kconfig
config ARMADEUS_FPGA_POD_BUTTON_DRIVER
	tristate "POD button"
	default n
	depends on POD_DRIVERS 
	select ARMADEUS_FPGA_VIRTUAL_COMPONENTS_BUTTON
	---help---
```

## src/library/components/i2cocore/drivers_templates/armadeus/Kconfig
```kconfig
config ARMADEUS_FPGA_POD_I2C_OCORE_DRIVER
	tristate "POD i2c driver"
	default n
	depends on POD_DRIVERS 
	---help---
```

## src/library/components/industrial_output/drivers_templates/armadeus/Kconfig
```kconfig
#
#

config OUTPUT_DRIVER
        tristate "Output driver"
        default m
        depends on POD_DRIVERS
        ---help---
```

## src/library/components/industrial_serial_input/drivers_templates/armadeus/Kconfig
```kconfig
#
#

config INPUT_DRIVER
        tristate "Input driver"
        default m
        depends on POD_DRIVERS
        ---help---
```

## src/library/components/irq_mngr/drivers_templates/armadeus/Kconfig
```kconfig
config ARMADEUS_FPGA_POD_IRQ_MNGR_DRIVER
	tristate "POD irq"
	default m
	depends on POD_DRIVERS
	select ARMADEUS_FPGA_VIRTUAL_COMPONENTS
	select ARMADEUS_FPGA_VIRTUAL_COMPONENTS_IRQ_MNGR
	---help---
```

## src/library/components/led/drivers_templates/armadeus/Kconfig
```kconfig
config ARMADEUS_FPGA_POD_LED_DRIVER
	tristate "POD led"
	default n
	depends on POD_DRIVERS 
	select ARMADEUS_FPGA_VIRTUAL_COMPONENTS_LED
	---help---
```

## src/library/components/pod_gpio/drivers_templates/armadeus/Kconfig
```kconfig
config ARMADEUS_FPGA_POD_GPIO_DRIVER
	tristate "pod_gpio_platform"
	default n
	depends on POD_DRIVERS 
	select ARMADEUS_FPGA_VIRTUAL_COMPONENTS_GPIO
	---help---
```

## src/library/components/pod_pwm/drivers_templates/armadeus/Kconfig
```kconfig
config ARMADEUS_FPGA_POD_PWM_DRIVER
	tristate "pod_pwm_platform"
	default n
	depends on POD_DRIVERS 
	select ARMADEUS_FPGA_VIRTUAL_COMPONENTS_PWM
	---help---
```

## src/library/components/pod_servo/drivers_templates/armadeus/Kconfig
```kconfig
config ARMADEUS_FPGA_POD_SERVO_DRIVER
	tristate "pod_servo_platform"
	default n
	depends on POD_DRIVERS 
	select ARMADEUS_FPGA_VIRTUAL_COMPONENTS_SERVO
	---help---
```

## src/library/components/sja1000/drivers_templates/armadeus/Kconfig
```kconfig
config ARMADEUS_FPGA_POD_SJA1000_DRIVER
	tristate "POD sja1000 driver"
	default m
	depends on POD_DRIVERS
	---help---
```

## src/library/components/sp_vision_configure/drivers_templates/armadeus/Kconfig
```kconfig
#

#
config ARMADEUS_FPGA_POD_SPVISION_PROBER_DRIVER
	tristate "pod sp_vision fpga loader"
	default n
	depends on POD_DRIVERS
	select ARMADEUS_FPGA_VIRTUAL_SPVISION_LOADER
	---help---
	  With this driver you will be able to load the configuration
	  of your sp_vision FPGA directly from Linux userspace.
```

## src/library/components/uart16750/drivers_templates/armadeus/Kconfig
```kconfig
config ARMADEUS_FPGA_POD_UART16750_DRIVER
	tristate "POD uart16750 driver"
	default m
	depends on POD_DRIVERS 
	---help---
```
